#include "otter.dtsi"

/ {
    kscan0: kscan0 {
        compatible = "zmk,kscan-gpio-matrix";
        diode-direction = "col2row";
        wakeup-source;

        col-gpios
            = <&pro_micro 6 GPIO_ACTIVE_HIGH> //0 + 5 = 5 
            , <&pro_micro 5 GPIO_ACTIVE_HIGH> //1 + 5 = 6
            , <&pro_micro 4 GPIO_ACTIVE_HIGH> //2 + 5 = 7
            , <&pro_micro 3 GPIO_ACTIVE_HIGH> //3 + 5 = 8
            , <&pro_micro 2 GPIO_ACTIVE_HIGH> //4 + 5 = 9
            ;

        row-gpios
            = <&pro_micro 21 (GPIO_ACTIVE_HIGH | GPIO_PULL_DOWN)> //0
            , <&pro_micro 20 (GPIO_ACTIVE_HIGH | GPIO_PULL_DOWN)> //1
            , <&pro_micro 19 (GPIO_ACTIVE_HIGH | GPIO_PULL_DOWN)> //2
            , <&pro_micro 18 (GPIO_ACTIVE_HIGH | GPIO_PULL_DOWN)> //3
            ;
    };
};

&matrix_transform0 {
    col-offset = <5>;
};

&physical_layout_otter {
    kscan = <&kscan0>;
};
